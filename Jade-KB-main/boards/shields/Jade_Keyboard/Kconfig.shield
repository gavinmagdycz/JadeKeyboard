## Jade-KB-main/boards/shields/Jade_Keyboard/Kconfig.shield
```kconfig
config JADE_KEYBOARD_LEFT
    def_bool $(shields_list_contains,Jade_Keyboard_left)
    
config JADE_KEYBOARD_RIGHT
    def_bool $(shields_list_contains,Jade_Keyboard_right)
```

## boards/shields/Jade_Keyboard/Kconfig.defconfig
```kconfig
if SHIELD_JADE_KEYBOARD_LEFT

config ZMK_KEYBOARD_NAME
    default "Jade's Keyboard"

config ZMK_SPLIT_ROLE_CENTRAL
    default y

endif

if SHIELD_JADE_KEYBOARD_LEFT || SHIELD_JADE_KEYBOARD_RIGHT

config ZMK_SPLIT
    default y

endif
```
